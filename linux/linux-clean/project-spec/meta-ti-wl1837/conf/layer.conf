## linux/linux-clean/project-spec/meta-ti-wl1837/conf/layer.conf
```bitbake
# We have a conf and classes directory, add to BBPATH
BBPATH .= ":${LAYERDIR}"
METATIBASE := '${@os.path.normpath("${LAYERDIR}/")}'

# We have recipes-* directories, add to BBFILES
BBFILES += "${LAYERDIR}/recipes-*/*/*.bb \
	${LAYERDIR}/recipes-*/*/*.bbappend"

BBFILE_COLLECTIONS += "meta-ti-wl1837"
BBFILE_PATTERN_meta-ti-wl1837 = "^${LAYERDIR}/"
BBFILE_PRIORITY_meta-ti-wl1837 = "6"

LAYERSERIES_COMPAT_meta-ti-wl1837 = "honister"
```
